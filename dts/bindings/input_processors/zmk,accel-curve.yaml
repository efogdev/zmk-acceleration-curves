## dts/bindings/input_processors/zmk,accel-curve.yaml
```yaml
description: Input processor for acceleration curves
compatible: "zmk,accel-curve"
include: ip_zero_param.yaml

properties:
  max-curves:
    type: int
    required: true
  points:
    type: int
    required: true
  device-name:
    type: string
    required: true
  event-codes:
    required: true
    type: array
```

## src/shell/Kconfig
```kconfig
if SHELL

config ZMK_ACCEL_CURVE_SHELL
    bool "Acceleration curve shell commands"
    default y

config ZMK_ACCEL_CURVE_MONITOR
    bool "Monitor mode"
    depends on ZMK_ACCEL_CURVE_SHELL
    default y

config ZMK_ACCEL_CURVE_MONITOR_AUTO_OFF_MSEC
    int "Auto-disable monitor after N ms of inactivity (0 = never)"
    depends on ZMK_ACCEL_CURVE_MONITOR
    default 30000

config ZMK_ACCEL_CURVE_MONITOR_BUF_SIZE
    int "Monitor output buffer size in bytes"
    depends on ZMK_ACCEL_CURVE_MONITOR
    default 64

config ZMK_ACCEL_CURVE_MONITOR_FLUSH_INTERVAL_MS
    int "Monitor flush interval in milliseconds"
    depends on ZMK_ACCEL_CURVE_MONITOR
    default 10

endif
```
