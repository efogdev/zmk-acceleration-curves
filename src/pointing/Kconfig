## src/pointing/Kconfig
```kconfig
if ZMK_POINTING

config ZMK_ACCEL_CURVE
    bool "Acceleration curves input processor"
    default y
    depends on INPUT

config ZMK_ACCEL_CURVE_DEAD_ZONE
    bool "Enable dead zone"
    depends on ZMK_ACCEL_CURVE
    default n

config ZMK_ACCEL_CURVE_DEAD_ZONE_BEFORE
    bool "Apply dead zone before acceleration"
    depends on ZMK_ACCEL_CURVE
    default n

config ZMK_ACCEL_CURVE_DEAD_ZONE_THRESHOLD
    int "Dead zone threshold"
    depends on ZMK_ACCEL_CURVE
    default 1

config ZMK_ACCEL_CURVE_DEAD_ZONE_COOLDOWN
    int "Dead zone cooldown (ms)"
    depends on ZMK_ACCEL_CURVE
    default 0

endif
```
